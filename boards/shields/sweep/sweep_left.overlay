#include "sweep.dtsi"

/* No encoder or trackpad hardware on this build.
&left_encoder {
	status = "okay";
};

&glidepoint_split {
	status = "okay";
};

&glidepoint_listener {
	status = "okay";
};
*/
